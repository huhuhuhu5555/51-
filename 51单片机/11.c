#include <REGX52.H>
#include <intrins.h>


/************************************************************
                        IO定义
************************************************************/

/* DS18B20数据线
   如果你的DQ不是P3.7，只修改这里 */
sbit DS18B20_DQ = P3^7;


/* 无源蜂鸣器 */
sbit BEEP = P2^5;


/* 数码管位选 */
sbit LSA = P2^2;
sbit LSB = P2^3;
sbit LSC = P2^4;


/************************************************************
                        类型定义
************************************************************/

typedef unsigned char u8;
typedef unsigned int  u16;


/************************************************************
                        全局变量
************************************************************/

/* 数码管显示缓存 */
u8 display_buf[3];

/* 当前有效温度 */
float temperature;


/* 报警标志
   0 = 不报警
   1 = 报警 */
bit alarm_flag;


/************************************************************
                  共阴极数码管段码
************************************************************/

/*
       --0--
      |     |
      5     1
      |     |
       --6--
      |     |
      4     2
      |     |
       --3--

P0.7 = 小数点

共阴极：
0 = 3F
1 = 06
2 = 5B
3 = 4F
4 = 66
5 = 6D
6 = 7D
7 = 07
8 = 7F
9 = 6F
*/

u8 smg_code[10] =
{
    0x3F,
    0x06,
    0x5B,
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    0x7F,
    0x6F
};


/************************************************************
                        10us延时
************************************************************/

void delay_10us(u16 time)
{
    u16 i;

    for(i = 0; i < time; i++)
    {
        _nop_();
        _nop_();
        _nop_();
        _nop_();
        _nop_();
    }
}


/************************************************************
                        毫秒延时
************************************************************/

void delay_ms(u16 time)
{
    u16 i;
    u16 j;

    for(i = 0; i < time; i++)
    {
        for(j = 0; j < 110; j++)
        {
            ;
        }
    }
}


/************************************************************
                    DS18B20复位
************************************************************/

void ds18b20_reset(void)
{
    DS18B20_DQ = 0;

    delay_10us(75);

    DS18B20_DQ = 1;

    delay_10us(2);
}


/************************************************************
                检测DS18B20是否存在
************************************************************/

u8 ds18b20_check(void)
{
    u8 time_temp;

    time_temp = 0;


    /* 等待DQ变低 */
    while(DS18B20_DQ && time_temp < 20)
    {
        time_temp++;

        delay_10us(1);
    }


    if(time_temp >= 20)
    {
        return 1;
    }


    time_temp = 0;


    /* 等待DQ变高 */
    while((!DS18B20_DQ) && time_temp < 20)
    {
        time_temp++;

        delay_10us(1);
    }


    if(time_temp >= 20)
    {
        return 1;
    }


    return 0;
}


/************************************************************
                  DS18B20读取1位
************************************************************/

u8 ds18b20_read_bit(void)
{
    u8 dat;

    dat = 0;


    DS18B20_DQ = 0;

    _nop_();
    _nop_();


    DS18B20_DQ = 1;

    _nop_();
    _nop_();


    if(DS18B20_DQ)
    {
        dat = 1;
    }
    else
    {
        dat = 0;
    }


    delay_10us(5);


    return dat;
}


/************************************************************
                  DS18B20读取1字节
************************************************************/

u8 ds18b20_read_byte(void)
{
    u8 i;
    u8 dat;
    u8 temp;

    i = 0;
    dat = 0;
    temp = 0;


    for(i = 0; i < 8; i++)
    {
        temp = ds18b20_read_bit();

        dat = (temp << 7) | (dat >> 1);
    }


    return dat;
}


/************************************************************
                  DS18B20写入1字节
************************************************************/

void ds18b20_write_byte(u8 dat)
{
    u8 i;
    u8 temp;

    i = 0;
    temp = 0;


    for(i = 0; i < 8; i++)
    {
        temp = dat & 0x01;

        dat = dat >> 1;


        if(temp)
        {
            DS18B20_DQ = 0;

            _nop_();
            _nop_();

            DS18B20_DQ = 1;

            delay_10us(6);
        }
        else
        {
            DS18B20_DQ = 0;

            delay_10us(6);

            DS18B20_DQ = 1;

            _nop_();
            _nop_();
        }
    }
}


/************************************************************
                DS18B20初始化
************************************************************/

u8 ds18b20_init(void)
{
    u8 result;

    result = 0;


    /*
       初始化时关闭中断，
       防止定时器影响DS18B20时序
    */

    EA = 0;


    ds18b20_reset();

    result = ds18b20_check();


    EA = 1;


    return result;
}


/************************************************************
                DS18B20读取温度

                成功返回1
                失败返回0

                成功后temperature保存温度
************************************************************/

u8 ds18b20_read_temperature(void)
{
    u8 data_low;
    u8 data_high;

    u16 value;


    data_low = 0;
    data_high = 0;
    value = 0;


    /************************************************
                    开始温度转换
    ************************************************/

    /*
       DS18B20通信时关闭中断
    */

    EA = 0;


    ds18b20_reset();


    if(ds18b20_check())
    {
        EA = 1;

        return 0;
    }


    /* 跳过ROM */
    ds18b20_write_byte(0xCC);


    /* 开始温度转换 */
    ds18b20_write_byte(0x44);


    /*
       转换命令已经发送完成
    */

    EA = 1;


    /************************************************
                    等待转换完成
    ************************************************/

    /*
       12位精度最长约750ms。

       这里等待800ms。
       
       等待期间保持中断开启，
       数码管继续动态扫描。
    */

    delay_ms(800);


    /************************************************
                    读取温度
    ************************************************/

    /*
       读取温度的整个通信过程
       再次关闭中断。
    */

    EA = 0;


    /* 重新复位 */
    ds18b20_reset();


    if(ds18b20_check())
    {
        EA = 1;

        return 0;
    }


    /* 跳过ROM */
    ds18b20_write_byte(0xCC);


    /* 读取暂存器 */
    ds18b20_write_byte(0xBE);


    /* 读取低8位 */
    data_low = ds18b20_read_byte();


    /* 读取高8位 */
    data_high = ds18b20_read_byte();


    /*
       通信结束
    */

    EA = 1;


    /************************************************
                    合并数据
    ************************************************/

    value = ((u16)data_high << 8) | data_low;


    /************************************************
                    判断明显错误
    ************************************************/

    if(value == 0xFFFF)
    {
        return 0;
    }


    /************************************************
                    计算温度
    ************************************************/

    if((value & 0xF800) == 0xF800)
    {
        /*
           负温度
        */

        value = (~value) + 1;

        temperature = value * (-0.0625);
    }
    else
    {
        /*
           正温度
        */

        temperature = value * 0.0625;
    }


    /************************************************
                    温度范围检查
    ************************************************/

    if(temperature < -55.0)
    {
        return 0;
    }


    if(temperature > 125.0)
    {
        return 0;
    }


    return 1;
}


/************************************************************
                    数码管位选
************************************************************/

void smg_select(u8 position)
{
    if(position == 1)
    {
        LSA = 1;
        LSB = 1;
        LSC = 1;
    }
    else if(position == 2)
    {
        LSA = 0;
        LSB = 1;
        LSC = 1;
    }
    else if(position == 3)
    {
        LSA = 1;
        LSB = 0;
        LSC = 1;
    }
}


/************************************************************
                数码管显示一位
************************************************************/

void smg_display_one(u8 position)
{
    u8 segment_value;


    /*
       消影
    */

    P0 = 0x00;


    /*
       位选
    */

    smg_select(position);


    /*
       段码
    */

    segment_value = smg_code[display_buf[position - 1]];


    /*
       第二位增加小数点

       例如：

       2 6. 1

       显示：

       26.1
    */

    if(position == 2)
    {
        segment_value = segment_value | 0x80;
    }


    /*
       输出
    */

    P0 = segment_value;
}


/************************************************************
                温度转换成数码管数据
************************************************************/

void temperature_to_display(float temp)
{
    u16 temp10;


    temp10 = 0;


    /*
       暂时只显示正温度
    */

    if(temp < 0)
    {
        display_buf[0] = 0;
        display_buf[1] = 0;
        display_buf[2] = 0;

        return;
    }


    /*
       26.1 × 10 = 261

       加0.5实现四舍五入
    */

    temp10 = (u16)(temp * 10.0 + 0.5);


    /*
       三位数码管最大显示99.9
    */

    if(temp10 > 999)
    {
        temp10 = 999;
    }


    /*
       百位
    */

    display_buf[0] = temp10 / 100;


    /*
       十位
    */

    display_buf[1] = (temp10 / 10) % 10;


    /*
       个位
    */

    display_buf[2] = temp10 % 10;
}


/************************************************************
                    定时器0初始化
************************************************************/

/*
    假设晶振：

    11.0592MHz

    定时器0约100us中断一次。
*/

void timer0_init(void)
{
    TMOD = TMOD & 0xF0;

    TMOD = TMOD | 0x01;


    /*
       100us左右
    */

    TH0 = 0xFF;

    TL0 = 0xA4;


    ET0 = 1;

    EA = 1;

    TR0 = 1;
}


/************************************************************
                    定时器0中断
************************************************************/

/*
    这里完成：

    1. 数码管动态扫描
    2. 蜂鸣器声音频率
    3. 蜂鸣器滴滴声节奏
*/

void timer0_isr(void) interrupt 1
{
    static u8 display_position = 0;

    /*
       sound_count：

       用于产生约1kHz声音
    */
    static u8 sound_count = 0;


    /*
       rhythm_count：

       用于控制：

       响200ms
       停300ms
    */
    static u16 rhythm_count = 0;


    /*
       beep_wave：

       当前声音方波状态
    */
    static bit beep_wave = 0;


    /*
       beep_enable：

       1 = 当前处于“滴”的阶段
       0 = 当前处于“停”的阶段
    */
    static bit beep_enable = 0;


    /************************************************
                    定时器重装
    ************************************************/

    TH0 = 0xFF;

    TL0 = 0xA4;


    /************************************************
                    数码管扫描
    ************************************************/

    display_position++;

    if(display_position > 3)
    {
        display_position = 1;
    }


    smg_display_one(display_position);


    /************************************************
                    蜂鸣器控制
    ************************************************/

    if(alarm_flag)
    {
        /********************************************
                滴滴声节奏

                100us × 2000
                = 200ms

                100us × 3000
                = 300ms
        ********************************************/

        rhythm_count++;


        /*
           当前正在“响”
        */

        if(beep_enable)
        {
            /*
               200ms以后停止
            */

            if(rhythm_count >= 2000)
            {
                rhythm_count = 0;

                beep_enable = 0;

                sound_count = 0;

                beep_wave = 0;

                BEEP = 0;
            }
            else
            {
                /*
                   产生约1kHz方波
                */

                sound_count++;


                if(sound_count >= 5)
                {
                    sound_count = 0;

                    beep_wave = !beep_wave;

                    BEEP = beep_wave;
                }
            }
        }


        /*
           当前正在“停”
        */

        else
        {
            BEEP = 0;


            /*
               停300ms以后重新响
            */

            if(rhythm_count >= 3000)
            {
                rhythm_count = 0;

                beep_enable = 1;

                sound_count = 0;

                beep_wave = 0;

                BEEP = 0;
            }
        }
    }


    /************************************************
                没有报警
    ************************************************/

    else
    {
        sound_count = 0;

        rhythm_count = 0;

        beep_wave = 0;

        beep_enable = 0;

        BEEP = 0;
    }
}


/************************************************************
                        主函数
************************************************************/

void main(void)
{
    u8 sensor_result;


    /************************************************
                    初始状态
    ************************************************/

    BEEP = 0;

    P0 = 0x00;


    /*
       开机先显示25.0
       防止数码管刚开机乱码
    */

    display_buf[0] = 2;
    display_buf[1] = 5;
    display_buf[2] = 0;


    /*
       初始温度
    */

    temperature = 25.0;


    /*
       初始不报警
    */

    alarm_flag = 0;


    /************************************************
                    DS18B20初始化
    ************************************************/

    sensor_result = ds18b20_init();


    /************************************************
                    定时器初始化
    ************************************************/

    timer0_init();


    /************************************************
                      主循环
    ************************************************/

    while(1)
    {
        /*
           sensor_result：

           0 = DS18B20正常
           1 = DS18B20没有检测到
        */

        if(sensor_result == 0)
        {
            /*
               读取温度

               成功：
               返回1

               失败：
               返回0
            */

            if(ds18b20_read_temperature())
            {
                /*
                   只有成功读取才更新显示
                */

                temperature_to_display(temperature);


                /****************************************
                         超过30℃开始报警
                    ****************************************/

                if(temperature > 30.0)
                {
                    alarm_flag = 1;
                }
                else
                {
                    alarm_flag = 0;
                }
            }


            /*
               如果本次读取失败：

               什么都不做。

               保持上一次正确温度。

               例如：

               26.1
               ↓
               读取失败
               ↓
               仍然显示26.1

               不会变成000。
            */
        }


        else
        {
            /*
               没有检测到DS18B20

               关闭报警
            */

            alarm_flag = 0;
        }


        /*
           两次采集之间稍微停一下
        */

        delay_ms(100);
    }
}